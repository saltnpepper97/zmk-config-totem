## Kconfig
```kconfig
menu "TOTEM extensions"

config TOTEM_BATTERY_TELEMETRY
    bool "Report split battery levels over the dongle USB console"
    default y if SHIELD_TOTEM_DONGLE
    depends on ZMK_SPLIT_ROLE_CENTRAL
    depends on ZMK_SPLIT_BLE_CENTRAL_BATTERY_LEVEL_FETCHING
    select PRINTK
    help
      Emit one compact line for each left/right peripheral battery update and
      repeat the latest readings once per minute for a host tray application.

config TOTEM_BATTERY_HEARTBEAT
    bool "Repeat each split peripheral battery level"
    default y if SHIELD_TOTEM_LEFT || SHIELD_TOTEM_RIGHT
    depends on ZMK_SPLIT
    depends on !ZMK_SPLIT_ROLE_CENTRAL
    depends on ZMK_BATTERY_REPORTING
    depends on BT_BAS
    help
      Notify the current Battery Service level once per minute so the split
      central receives a fresh value after reconnecting even when the integer
      battery percentage has not changed.

config TOTEM_BATTERY_DIAGNOSTICS
    bool "Print the peripheral's measured battery voltage"
    default n
    depends on TOTEM_BATTERY_HEARTBEAT
    select PRINTK
    help
      Sample the physical battery sensor and print its measured millivolts and
      calculated percentage once per minute. Intended for USB diagnostic
      builds of the left and right halves.

endmenu
```
