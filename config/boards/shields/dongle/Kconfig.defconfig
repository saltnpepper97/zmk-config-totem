## config/boards/shields/dongle/Kconfig.defconfig
```kconfig
if SHIELD_DONGLE

config ZMK_SPLIT
    default y

config ZMK_SPLIT_ROLE_CENTRAL
    default y

config ZMK_USB
    default y

config ZMK_BLE
    default y

endif
```
